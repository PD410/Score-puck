// Updated mets_logo.cpp with scaling support

#include "mets_logo.h"

// Logo constants
const int METS_LOGO_WIDTH = 77;
const int METS_LOGO_HEIGHT = 112;

// Complete bitmap data with proper closing
const unsigned char mets_logo_bitmap[] PROGMEM = {
  0x00, 0x00, 0x00, 0x00, 0x00, 0x00, 0x00, 0x00, 0x00, 0x00, 0x03, 0xf0, 0x1f, 0x80, 0x00, 0x00, 
  0x1f, 0x80, 0x7e, 0x00, 0x0f, 0xfc, 0x7f, 0xe0, 0x00, 0x00, 0x7f, 0xe3, 0xff, 0x00, 0x1f, 0xff, 
  0xff, 0xf0, 0x00, 0x00, 0xff, 0xff, 0xff, 0x80, 0x1f, 0xff, 0xff, 0xf8, 0x00, 0x00, 0xff, 0xff, 
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  0xc0, 0x1f, 0x80, 0x00, 0x00, 0x00, 0x00, 0x00, 0x00, 0x00, 0x00, 0x00, 0x00, 0x00, 0x00, 0x00
};

// Reference to the global display object
extern Adafruit_GC9A01A tft;

// Function to draw inverted logo (original function)
void drawMetsLogoInverted(int x, int y, uint16_t fgColor, uint16_t bgColor) {
  for (int16_t j = 0; j < METS_LOGO_HEIGHT; j++) {
    for (int16_t i = 0; i < METS_LOGO_WIDTH; i++) {
      int16_t pixelX = x + i;
      int16_t pixelY = y + j;
      
      // Bounds checking
      if (pixelX < 0 || pixelX >= 240 || pixelY < 0 || pixelY >= 240) continue;
      
      int16_t byteWidth = (METS_LOGO_WIDTH + 7) / 8;
      uint8_t byte = pgm_read_byte(&mets_logo_bitmap[j * byteWidth + i / 8]);
      
      // Inverted logic: draw fgColor for logo pixels (1s), bgColor for background (0s)
      if (byte & (128 >> (i & 7))) {
        tft.drawPixel(pixelX, pixelY, fgColor);  // Logo pixels
      } else {
        tft.drawPixel(pixelX, pixelY, bgColor);  // Background pixels
      }
    }
  }
}

// Function to get gradient color at specific position (declared as extern)
extern uint16_t getBlueGradientColorAtXY(int x, int y);

// New function to draw logo with gradient background preservation and scaling support
void drawMetsLogoWithGradientBackground(int x, int y, uint16_t logoColor, int scale) {
  // Calculate scaled dimensions
  int scaledWidth = METS_LOGO_WIDTH / scale;
  int scaledHeight = METS_LOGO_HEIGHT / scale;
  
  for (int16_t j = 0; j < scaledHeight; j++) {
    for (int16_t i = 0; i < scaledWidth; i++) {
      int16_t pixelX = x + i;
      int16_t pixelY = y + j;
      
      // Bounds checking
      if (pixelX < 0 || pixelX >= 240 || pixelY < 0 || pixelY >= 240) continue;
      
      // Sample from original bitmap using scaling
      int16_t origI = i * scale;
      int16_t origJ = j * scale;
      
      // Make sure we don't go out of bounds of original bitmap
      if (origI >= METS_LOGO_WIDTH || origJ >= METS_LOGO_HEIGHT) continue;
      
      int16_t byteWidth = (METS_LOGO_WIDTH + 7) / 8;
      uint8_t byte = pgm_read_byte(&mets_logo_bitmap[origJ * byteWidth + origI / 8]);
      
      // For logo pixels (1s), use the orange logo color
      // For background pixels (0s), use the gradient color at that position
      if (byte & (128 >> (origI & 7))) {
        tft.drawPixel(pixelX, pixelY, logoColor);  // Orange logo pixels
      } else {
        // Get the gradient color for this specific position
        uint16_t gradientColor = getBlueGradientColorAtXY(pixelX, pixelY);
        tft.drawPixel(pixelX, pixelY, gradientColor);  // Gradient background
      }
    }
  }
}

// Helper function to get scaled logo dimensions
void getScaledLogoDimensions(int scale, int* width, int* height) {
  *width = METS_LOGO_WIDTH / scale;
  *height = METS_LOGO_HEIGHT / scale;
}